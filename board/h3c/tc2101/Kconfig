## board/h3c/tc2101/Kconfig
```kconfig
if TARGET_TC2101

config SYS_BOARD
        default "tc2101"

config SYS_VENDOR
        default "h3c"

config SYS_CONFIG_NAME
        default "tc2101"

endif
```

## board/sigmastar/ssc337-nor/Kconfig
```kconfig
if TARGET_SSC337_NOR

config SYS_BOARD
	default "ssc337-nor"

config SYS_VENDOR
	default "sigmastar"

config SYS_SOC
	default "ssc337"

config SYS_CONFIG_NAME
	default "ssc337-nor"

endif
```
